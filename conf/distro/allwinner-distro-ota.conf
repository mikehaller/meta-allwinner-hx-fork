## conf/distro/allwinner-distro-ota.conf
```bitbake
require conf/distro/poky.conf

DISTRO = "allwinner-distro-base"
DISTRO_NAME = "Allwinner Distro Base"
SDK_VENDOR = "-allwinnersdk"

MAINTAINER = "Dimitris Tassopoulos <dimtass@gmail.com>"

TARGET_VENDOR = "-allwinner"

# Allwinner BSP default settings

VIRTUAL-RUNTIME_init_manager = "systemd"
DISTRO_FEATURES_BACKFILL_CONSIDERED = "sysvinit"
VIRTUAL-RUNTIME_initscripts = ""

DISTRO = "allwinner-distro-ota"
DISTRO_NAME = "Allwinner no backend"

# Remove conflicting backends.
DISTRO_FEATURES_remove = "wayland x11 alsa apm keyboard rtc serial screen bluetooth bluez5"
```

## conf/distro/allwinner-distro-wayland.conf
```bitbake
require conf/distro/include/allwinner-distro-base.inc

DISTRO = "allwinner-distro-console"
DISTRO_NAME = "Allwinner wayland"

# Remove conflicting backends.
DISTRO_FEATURES:remove = "x11"

# Only compatible with poky versions > zeus (mesa >= 19.1)
PACKAGECONFIG:append:pn-virtual/mesa = "gallium lima"
```

## conf/distro/allwinner-distro-x11.conf
```bitbake
require conf/distro/include/allwinner-distro-base.inc

DISTRO = "allwinner-distro-x11"
DISTRO_NAME = "Allwinner X11"

# Remove conflicting backends.
DISTRO_FEATURES:remove = "wayland"

# Only compatible with poky versions > zeus (mesa >= 19.1)
PACKAGECONFIG:append:pn-virtual/mesa = "gallium lima"
```

## conf/machine/rervision-dvk-h3.conf
```bitbake
#@TYPE: Machine
#@NAME: rervision-dvk-h3
#@DESCRIPTION: Machine configuration for the rervision-dvk-h3, base on allwinner H3 CPU

require conf/machine/include/sun8i.inc

# KERNEL_DEVICETREE is already set in sun8i.inc to support the overlays
# and SUNXI_KERNEL_DEVICETREE will be appended to KERNEL_DEVICETREE
SUNXI_KERNEL_DEVICETREE = "sun8i-h3-rervision-dvk.dtb"
UBOOT_CONFIG = "rervision_dvk_h3_defconfig"

DEFAULT_OVERLAYS = ""
MODULES = ""
MODULES_BLACKLIST = ""

MACHINE_FEATURES_append ?= "wifi"
IMAGE_INSTALL_append ?= "util-linux ffmpeg simcom-wwan minicom dhcp-server \
                         dhcp-client p7zip python3-pip bmap-tools ntp v4l-utils \
                         paho-mqtt-cpp libpng opencv opencv-samples swupdate \
                         swupdate-www"

LICENSE_FLAGS_WHITELIST += "commercial"
MACHINE_EXTRA_RRECOMMENDS += "kernel-module-simcomwwan"
ROOT_EXTRA_SPACE = "1024"
# SUNXI_STORAGE_DEVICE_sun8i = "mmcblk2"

IMAGE_FSTYPES += " ext4.gz"
# PREFERRED_PROVIDER_u-boot-fw-utils = "libubootenv"
```
